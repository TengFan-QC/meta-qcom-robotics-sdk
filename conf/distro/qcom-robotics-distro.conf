## conf/layer.conf
```bitbake
BBFILES += "${LAYERDIR}/recipes/*/*.bb \
            ${LAYERDIR}/recipes/*/*.bbappend \
            ${LAYERDIR}/recipes/*/*/*.bb \
            ${LAYERDIR}/recipes/*/*/*.bbappend \
            ${LAYERDIR}/recipes-*/*/*.bb \
            ${LAYERDIR}/recipes-*/*/*.bbappend \
            ${LAYERDIR}/recipes-*/*.bb \
            ${LAYERDIR}/recipes-*/*.bbappend \
            ${LAYERDIR}/recipes/*/*/*/*.bb \
            ${LAYERDIR}/recipes-*/*/*/*.bb \
            ${LAYERDIR}/recipes-*/*/*/*.bbappend \
"

BBFILES_DYNAMIC += " \
    qti-automotive:${LAYERDIR}/dynamic-layers/qti-automotive/*/*/*.bb \
    qti-automotive:${LAYERDIR}/dynamic-layers/qti-automotive/*/*/*.bbappend \
"

BBPATH .= ":${LAYERDIR}"
BBFILE_COLLECTIONS += "meta-qcom-robotics-sdk"
BBFILE_PRIORITY_meta-qcom-robotics-sdk = "13"
BBFILE_PATTERN_meta-qcom-robotics-sdk := "^${LAYERDIR}/"
LAYERSERIES_COMPAT_meta-qcom-robotics-sdk = "wrynose"

PREFERRED_VERSION_realsense2-camera = "4.58.4-1"
PREFERRED_VERSION_librealsense2 = "2.58.4"

QRB_ROS_SAMPLE_REV = "08da75d9952ba5d256c55a3773ed58031b187896"

ros_base_prefix = "/usr/ros/${ROS_DISTRO}"
ROS_UNRESOLVED_DEP-libnanoflann-dev:forcevariable = "nanoflann"

ROBIOTICS_LAYER_DIR = "${LAYERDIR}"

ROBOTICS_PACKAGEGROUP_LIST_DIR = "${DEPLOY_DIR}/packagegroup-lists/${MACHINE_ARCH}"

# All the download files of meta-qcom layer have been deployed on this server.
QLI_BASELINE ?= "2.x"
QLI_MIRRORS_URI ?= "https://artifacts.codelinaro.org/artifactory/qli-ci/downloads/${QLI_BASELINE}"

PREMIRRORS:prepend = "\
.*://.*/.* ${QLI_MIRRORS_URI}/ \n \
"

ROBOTICS_PACKAGEGROUP_LIST_DIR = "${DEPLOY_DIR}/packagegroup-lists/${MACHINE_ARCH}"
```
